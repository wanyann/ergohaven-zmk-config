## config/boards/shields/ergohaven_hpd_v2/Kconfig.defconfig
```kconfig
if SHIELD_ERGOHAVEN_HPD_V2_LEFT

config ZMK_KEYBOARD_NAME
    default "Ergohaven HPD v2"

endif

if SHIELD_ERGOHAVEN_HPD_V2_RIGHT

config ZMK_KEYBOARD_NAME
    default "Ergohaven HPD v2"

endif
```

## config/boards/shields/ergohaven_hpd_v2/Kconfig.shield
```kconfig
config SHIELD_ERGOHAVEN_HPD_V2_LEFT
    def_bool $(shields_list_contains,ergohaven_hpd_v2_left)

config SHIELD_ERGOHAVEN_HPD_V2_RIGHT
    def_bool $(shields_list_contains,ergohaven_hpd_v2_right)
```

## config/boards/shields/ergohaven_hpd_v2_left/Kconfig.defconfig
```kconfig
if SHIELD_ERGOHAVEN_HPD_V2_LEFT

config ZMK_KEYBOARD_NAME
    default "Ergohaven HPD v2"

endif
```

## config/boards/shields/ergohaven_hpd_v2_right/Kconfig.defconfig
```kconfig
if SHIELD_ERGOHAVEN_HPD_V2_RIGHT

config ZMK_KEYBOARD_NAME
    default "Ergohaven HPD v2"

endif
```

## config/boards/shields/phenom/Kconfig.defconfig
```kconfig
if SHIELD_PHENOM_LEFT

config ZMK_KEYBOARD_NAME
    default "Phenom"

endif

if SHIELD_PHENOM_RIGHT

config ZMK_KEYBOARD_NAME
    default "Phenom"

endif
```

## config/boards/shields/phenom/Kconfig.shield
```kconfig
config SHIELD_PHENOM_LEFT
    def_bool $(shields_list_contains,phenom_left)

config SHIELD_PHENOM_RIGHT
    def_bool $(shields_list_contains,phenom_right)
```

## config/boards/shields/phenom_mini/Kconfig.defconfig
```kconfig
if SHIELD_PHENOM_MINI_LEFT

config ZMK_KEYBOARD_NAME
    default "Phenom Mini"

endif

if SHIELD_PHENOM_MINI_RIGHT

config ZMK_KEYBOARD_NAME
    default "Phenom Mini"

endif
```

## config/boards/shields/phenom_mini/Kconfig.shield
```kconfig
config SHIELD_PHENOM_MINI_LEFT
    def_bool $(shields_list_contains,phenom_mini_left)

config SHIELD_PHENOM_MINI_RIGHT
    def_bool $(shields_list_contains,phenom_mini_right)
```

## config/west.yml
```yaml
manifest:
  remotes:
    - name: ergohaven
      url-base: https://github.com/ergohaven
    - name: wanyann
      url-base: https://github.com/wanyann
    - name: oleksandrmaslov
      url-base: https://github.com/oleksandrmaslov  
    - name: amgskobo
      url-base: https://github.com/amgskobo
  projects:
    - name: ergohaven-zmk
      remote: wanyann
      revision: main
      import: config/west.yml
    - name: zephyr
      remote: wanyann
      revision: phenom-mini/ws2812-irq-lock
      clone-depth: 1
      import:
        name-blocklist:
          - ci-tools
          - hal_altera
          - hal_cypress
          - hal_infineon
          - hal_microchip
          - hal_nxp
          - hal_openisa
          - hal_silabs
          - hal_xtensa
          - hal_st
          - hal_ti
          - loramac-node
          - mcuboot
          - mcumgr
          - net-tools
          - openthread
          - edtt
          - trusted-firmware-m
    - name: zmk-pointing-acceleration
      remote: oleksandrmaslov
      revision: main
    - name: zmk-input-inertia
      remote: wanyann
      revision: main
  self:
    path: config
```

## dts/bindings/led_strip/ergohaven,ws2812-gpio.yaml
```yaml
description: |
  Minimal bit-banged WS2812 LED strip driver for RP2040 (used on the
  phenom_mini layer indicator LED wired to a plain GPIO).

compatible: "ergohaven,ws2812-gpio"

include: [base.yaml]

properties:
  in-gpios:
    type: phandle-array
    required: true
    description: |
      GPIO phandle and specifier for the pin connected to the LED's
      input. Exactly one pin should be given.

  chain-length:
    type: int
    required: true
    default: 1
    description: |
      The number of devices in the daisy-chain.

  color-mapping:
    type: array
    required: true
    description: |
      Channel to color mapping (e.g. GRB below).

  reset-delay:
    type: int
    default: 8
    description: |
      Minimum delay in microseconds to hold the data line low to latch
      the frame. The driver also applies a fixed reset pulse.
```

## dts/bindings/sensor/ergohaven,pmw3610-gpio.yaml
```yaml
description: |
  Bit-banged 3-wire SPI polling driver for the PMW3610 mouse sensor on
  RP2040. Mirrors the proven QMK firmware wiring on the phenom right
  half: SCLK=GP10, SDIO=GP11, CS=GP9, no motion/int pin, polled on a
  period timer (no interrupt).

compatible: "ergohaven,pmw3610-gpio"

include: [base.yaml]

properties:
  sclk-gpios:
    type: phandle-array
    required: true
    description: |
      GPIO wired to the PMW3610 SCLK pin.

  sdio-gpios:
    type: phandle-array
    required: true
    description: |
      GPIO wired to the PMW3610 SDIO pin (bi-directional data).

  cs-gpios:
    type: phandle-array
    required: true
    description: |
      GPIO wired to the PMW3610 CS (chip select) pin, active low.

  cpi:
    type: int
    default: 600
    description: |
      Sensor resolution in counts per inch (200-3200, step 200).

  run-downshift-ms:
    type: int
    default: 128
    description: |
      Time of sensor inactivity (ms) before downshifting from Run to
      Rest1. Register value = time / 32 ms (8 * fixed 4ms pos-rate), same
      scaling as QMK set_downshift_time(PMW3610_REG_RUN_DOWNSHIFT, ...).

  rest1-downshift-ms:
    type: int
    default: 9600
    description: |
      Time of sensor inactivity (ms) before downshifting from Rest1 to
      Rest2. Register value = time / (16 * Rest1_sample_period, 40 ms),
      same scaling as QMK set_downshift_time(PMW3610_REG_REST1_DOWNSHIFT,
      ...).

  evt-type:
    type: int
    required: true
    description: |
      Input event type for the reported movement (e.g. INPUT_EV_REL).

  x-input-code:
    type: int
    required: true
    description: |
      Input event code for the X axis (e.g. INPUT_REL_X).

  y-input-code:
    type: int
    required: true
    description: |
      Input event code for the Y axis (e.g. INPUT_REL_Y).

  swap-xy:
    type: boolean
    description: |
      Swap the X and Y axis.

  invert-x:
    type: boolean
    description: |
      Invert the X axis.

  invert-y:
    type: boolean
    description: |
      Invert the Y axis.
```

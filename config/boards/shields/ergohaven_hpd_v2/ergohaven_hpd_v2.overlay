#include <dt-bindings/gpio/gpio.h>
#include <dt-bindings/zmk/keys.h>

/ {
    chosen {
        zmk,kscan = &kscan0;
        zmk,matrix-transform = &default_transform;
    };

    default_transform: keymap_transform_0 {
        compatible = "zmk,matrix-transform";
        columns = <12>;
        rows = <5>;
        map = <
            0  1  2  3  4  5       6  7  8  9 10 11
           12 13 14 15 16 17      18 19 20 21 22 23
           24 25 26 27 28 29      30 31 32 33 34 35
           36 37 38 39 40 41      42 43 44 45 46 47
           48 49 50 51 52 53      54 55 56 57 58 59
    };

    kscan0: kscan {
        compatible = "zmk,kscan-gpio-matrix";
        diode-direction = "col2row";
        
        row-gpios 
            = <&gpio0 6 (GPIO_ACTIVE_HIGH | GPIO_PULL_DOWN)>
            , <&gpio0 5 (GPIO_ACTIVE_HIGH | GPIO_PULL_DOWN)>
            , <&gpio0 4 (GPIO_ACTIVE_HIGH | GPIO_PULL_DOWN)>
            , <&gpio0 3 (GPIO_ACTIVE_HIGH | GPIO_PULL_DOWN)>
            , <&gpio0 2 (GPIO_ACTIVE_HIGH | GPIO_PULL_DOWN)>
            ;
            
        col-gpios 
            = <&gpio0 7 GPIO_ACTIVE_HIGH>
            , <&gpio0 12 GPIO_ACTIVE_HIGH>
            , <&gpio0 13 GPIO_ACTIVE_HIGH>
            , <&gpio0 14 GPIO_ACTIVE_HIGH>
            , <&gpio0 15 GPIO_ACTIVE_HIGH>
            , <&gpio0 28 GPIO_ACTIVE_HIGH>
            ;
    };

    wired_split: wired_split {
        compatible = "zmk,wired-split";
        device = <&uart0>;
    };
};

&uart0 {
    status = "okay";
    current-speed = <1000000>;
};